// SPDX-License-Identifier: GPL-2.0-only

/dts-v1/;

/ {
	model = "Motorola Moto E 2015 LTE (surnia)";
	compatible = "motorola,surnia", "qcom,msm8916";

    qcom,msm-id = <206 0>;
    qcom,board-id = <0x46 0x8300>;

    /*
	 * This is not used by lk2nd, for some reason the Motorola bootloader
	 * wants to update some properties in here. Meh.
	 */
	soc {
		qcom,mdss_dsi_mot_boe_450_qhd_video_v3 {
			compatible = "qcom,mdss-dsi-panel";
		};
		qcom,mdss_dsi_mot_inx_450_qhd_video_v1 {
			compatible = "qcom,mdss-dsi-panel";
		};
	};
};